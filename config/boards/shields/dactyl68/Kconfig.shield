## config/boards/shields/dactyl68/Kconfig.shield
```kconfig
# Copyright (c) 2020 Ryan Cross
# SPDX-License-Identifier: MIT

config SHIELD_DACTYL68_LEFT
    def_bool $(shields_list_contains,dactyl68_left)

config SHIELD_DACTYL68_RIGHT
    def_bool $(shields_list_contains,dactyl68_right)
```
